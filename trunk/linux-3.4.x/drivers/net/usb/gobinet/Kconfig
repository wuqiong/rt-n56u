## trunk/linux-3.4.x/drivers/net/usb/gobinet/Kconfig
```kconfig
#
# GobiNet driver configuration.
#

comment "GobiNet Drivers"



#
# USB Transceiver Drivers
#
config USB_GOBINET
	tristate "GobiNet Drivers"
	default m
	select CONFIG_USBNET
	help
	  Provides GobiNet LTE driver
```
